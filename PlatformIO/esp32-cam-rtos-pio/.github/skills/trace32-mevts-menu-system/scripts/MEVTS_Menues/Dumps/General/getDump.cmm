ENTRY &section

&dir=OS.PPD()
chdir &dir

if &section=="irom0"
(
&start=0x10000000
&end=0x1001ffff
)
else if &section=="iram0"
(
&start=0x20000000
&end=0x203fffff
)
else if &section=="dram0"
(
&start=0x30000000
&end=0x303fffff
)
else if &section=="dram1"
(
&start=0x40000000
&end=0x403fffff
)
else
(
ENDDO
)

&start=0x10000000
&end=0x1001ffff

&clock=CLOCK.SECONDS();
&dump_dir=&section

OS.HIDDEN MKDIR &(dump_dir);

&targetFilePath="&(dump_dir)\&(dump_dir)_&(clock).bin"


DATA.save.BINARY &targetFilePath D:&start--D:&end

DO ..\..\Dump_open.cmm &targetFilePath
ENDDO